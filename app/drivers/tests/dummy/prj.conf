## CMakeLists.txt
```
cmake_minimum_required(VERSION 3.20.0)

include(ztest_build_extensions)

zephyr_include_module(:self)

find_package(Zephyr COMPONENTS ztest_build_ext HINTS $ENV{ZEPHYR_BASE})

project(dummy_test)

target_sources(app PRIVATE src/main.c)
```

## prj.conf
```kconfig
CONFIG_UT_LOGGING=y
CONFIG_UT_MALLOC=y
CONFIG_UT_RING_BUFFER=y
CONFIG_APP_DRIVERS_DUMMY=y
```

## src/main.c
```c
/*
 * Copyright (c) 2016 Intel Corporation
 *
 * SPDX-License-Identifier: Apache-2.0
 */

#include <zephyr/ztest.h>
#include <dummy/dummy.h>


ZTEST_SUITE(dummy_test, NULL, NULL, NULL, NULL, NULL);


ZTEST(dummy_test, test_assert)
{
	zassert_true(get_dummy_ok(), "Dummy is not ok!");
}
```
